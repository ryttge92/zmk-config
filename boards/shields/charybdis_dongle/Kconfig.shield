## boards/shields/charybdis_dongle/Kconfig.shield
```kconfig
config SHIELD_CHARYBDIS_LEFT
    def_bool $(shields_list_contains,CHARYBDIS_left)

config SHIELD_CHARYBDIS_RIGHT
    def_bool $(shields_list_contains,CHARYBDIS_right)

config SHIELD_CHARYBDIS_DONGLE
    def_bool $(shields_list_contains,CHARYBDIS_dongle)
```
