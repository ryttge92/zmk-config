## boards/shields/dactyl_ryttge_dongle/Kconfig.shield
```kconfig
config SHIELD_DACTYL_RYTTGE_LEFT
    def_bool $(shields_list_contains,dactyl_ryttge_left)

config SHIELD_DACTYL_RYTTGE_RIGHT
    def_bool $(shields_list_contains,dactyl_ryttge_right)

config SHIELD_DACTYL_RYTTGE_DONGLE
    def_bool $(shields_list_contains,dactyl_ryttge_dongle)
```

## config/west.yml
```yaml
manifest:
  remotes:
    - name: zmkfirmware
      url-base: https://github.com/zmkfirmware
    - name: badjeff
      url-base: https://github.com/badjeff/
    - name: efogdev
      url-base: https://github.com/efogdev
    - name: nuovotaka
      url-base: https://github.com/nuovotaka
    - name: janpfischer
      url-base: https://github.com/janpfischer
    - name: michaelcoquet
      url-base: https://github.com/michaelcoquet

  projects:
    - name: zmk
      remote: zmkfirmware
      #revision: main
      revision: v0.3
      import: app/west.yml
    - name: zmk-pmw3610-driver
      remote: efogdev
      #revision: zephyr-4.1
      revision: main
    - name: zmk-input-processor-report-rate-limit
      remote: badjeff
      revision: main
    - name: zmk-pointing-acceleration-alpha
      remote: nuovotaka
      revision: main
    #- name: zmk-pmw3610-driver
    # remote: badjeff
      #revision: zmk-0.4
    #  revision: zmk-0.3
    - name: zmk-dongle-screen
      remote: janpfischer
      revision: main
    - name: zmk-driver-pim447 # PIM447 trackball, Dactyl-Ryttge left half
      remote: michaelcoquet
      revision: 9713fb6b1b88f332a725040f2ab0a7a4993dee86 # pinned commit

  self:
    path: config
```
