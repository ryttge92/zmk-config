## boards/shields/dactyl_manuform_5x7/Kconfig.shield
```kconfig
config SHIELD_DACTYL_MANUFORM_5x7_SA_LEFT
    def_bool $(shields_list_contains,dactyl_manuform_5x7_sa_left)

config SHIELD_DACTYL_MANUFORM_5x7_SA_RIGHT
    def_bool $(shields_list_contains,dactyl_manuform_5x7_sa_right)
```

## config/west.yml
```yaml
manifest:
  remotes:
    - name: zmkfirmware
      url-base: https://github.com/zmkfirmware
    - name: badjeff
      url-base: https://github.com/badjeff/
    - name: efogdev
      url-base: https://github.com/efogdev
    - name: nuovotaka
      url-base: https://github.com/nuovotaka
    - name: janpfischer
      url-base: https://github.com/janpfischer

  projects:
    - name: zmk
      remote: zmkfirmware
      #revision: main
      revision: v0.3
      import: app/west.yml
    - name: zmk-pmw3610-driver
      remote: efogdev
      #revision: zephyr-4.1
      revision: main
    #- name: zmk-input-processor-report-rate-limit
    #  remote: badjeff
    #  revision: main
    - name: zmk-pointing-acceleration-alpha
      remote: nuovotaka
      revision: main
    #- name: zmk-pmw3610-driver
    # remote: badjeff
      #revision: zmk-0.4
    #  revision: zmk-0.3
    - name: zmk-dongle-screen
      remote: janpfischer
      revision: main
      
  self:
    path: config
```
